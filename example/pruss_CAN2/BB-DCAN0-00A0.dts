/dts-v1/;
/plugin/;
  
/ {
    compatible = "ti,beaglebone", "ti,beaglebone-black";
  
    /* identification */
    part-number = "dcan0pinmux";
  
    fragment@0 {
        target = <&am33xx_pinmux>;
        __overlay__ {
            dcan0_pins_s0: dcan0_pins_s0 {
                pinctrl-single,pins = <
                    0x178 0x12  /* d_can0_tx, SLEWCTRL_FAST | INPUT_PULLUP | MODE2 */
                    0x17C 0x32  /* d_can0_rx, SLEWCTRL_FAST | RECV_ENABLE | INPUT_PULLUP | MODE2 */
                >;
            };
        };
    };
  
    fragment@1 {
        target = <&dcan0>;
        __overlay__ {
             #address-cells = <1>;
             #size-cells = <0>;
  
             status = "okay";
             pinctrl-names = "default";
             pinctrl-0 = <&dcan0_pins_s0>;
        };
    };
};