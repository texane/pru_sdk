/dts-v1/;
/plugin/;

/ {
	compatible = "ti,beaglebone", "ti,beaglebone-black";

	/* identification */
	part-number = "pru_enable";
	version = "00A0";

 	fragment@0 {
  		   target = <&pruss>;
		   __overlay__ {
		   	       status = "okay";

    	           };
        };

};
